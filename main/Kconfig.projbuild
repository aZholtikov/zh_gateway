## main/Kconfig.projbuild
```kconfig
menu "ZH Gateway Configuration"
	
	choice NETWORK_TYPE
		prompt "Network type"
		help
			Network type.
		default NETWORK_TYPE_DIRECT
		config NETWORK_TYPE_DIRECT
			bool "DIRECT"
		config NETWORK_TYPE_MESH
			bool "MESH"
	endchoice

	choice CONNECTION_TYPE
		prompt "Connection type"
		help
			Connection type.
		default CONNECTION_TYPE_WIFI
		config CONNECTION_TYPE_WIFI
			bool "WIFI"
		config CONNECTION_TYPE_LAN
			bool "LAN"
	endchoice

	config WIFI_SSID_NAME
		depends on CONNECTION_TYPE_WIFI
		string "WiFi SSID name"
		default "ssid"
		help
			WiFi SSID name.

	config WIFI_PASSWORD
		depends on CONNECTION_TYPE_WIFI
		string "WiFi password"
		default "password"
		help
			WiFi password.

	config MQTT_BROKER_URL
		string "MQTT broker url"
		default "mqtt://mqttbroker.com"
		help
			MQTT broker url.

	config MQTT_TOPIC_PREFIX
		string "MQTT topic prefix"
		default "homeassistant"
		help
			MQTT topic prefix.

	config SYSLOG_SERVER_USING
		bool "Enable using Syslog server"
		default true
		help
			Enable using Syslog server.

	config SYSLOG_SERVER_IP
		depends on SYSLOG_SERVER_USING
		string "Syslog server IP"
		default "192.168.1.2"
		help
			Syslog server IP.

	config SYSLOG_SERVER_PORT
		depends on SYSLOG_SERVER_USING
		int "Syslog server port"
		range 0 65635
		default 514
		help
			Syslog server port.
	
	config NTP_SERVER_USING
		bool "Enable using NTP server"
		default true
		help
			Enable using NTP server.

	config NTP_SERVER_URL
		depends on NTP_SERVER_USING
		string "NTP server url"
		default "ntpserver.com"
		help
			NTP server url.

	config NTP_TIME_ZONE
		depends on NTP_SERVER_USING
		string "NTP time zone"
		default "UTC-3"
		help
			NTP time zone.

	config FIRMWARE_UPGRADE_SERVER_USING
		bool "Enable using OTA update"
		default true
		help
			Enable using OTA update.

	config FIRMWARE_UPGRADE_URL
		depends on FIRMWARE_UPGRADE_SERVER_USING
		string "Firmware upgrade url"
		default "https://yourserver.com"
		help
			Firmware upgrade url. The certificate (certificate.pem) must match the upgrade server!

endmenu 
```

## sdkconfig.defaults
```kconfig
CONFIG_BOOTLOADER_OFFSET_IN_FLASH=0x1000
CONFIG_BOOTLOADER_COMPILER_OPTIMIZATION_SIZE=y
CONFIG_BOOTLOADER_LOG_LEVEL_NONE=y
CONFIG_BOOTLOADER_LOG_LEVEL=0
CONFIG_BOOTLOADER_APP_ROLLBACK_ENABLE=y

CONFIG_ESPTOOLPY_FLASHSIZE_4MB=y
CONFIG_ESPTOOLPY_FLASHSIZE="4MB"

CONFIG_PARTITION_TABLE_CUSTOM=y
CONFIG_PARTITION_TABLE_CUSTOM_FILENAME="partitions.csv"
CONFIG_PARTITION_TABLE_FILENAME="partitions.csv"
CONFIG_PARTITION_TABLE_OFFSET=0x8000
CONFIG_PARTITION_TABLE_MD5=y

CONFIG_COMPILER_OPTIMIZATION_SIZE=y

CONFIG_LOG_DEFAULT_LEVEL_NONE=y
CONFIG_LOG_DEFAULT_LEVEL=0

CONFIG_LWIP_LOCAL_HOSTNAME="gateway"

CONFIG_MQTT_SKIP_PUBLISH_IF_DISCONNECTED=y

CONFIG_ESP_SYSTEM_EVENT_TASK_STACK_SIZE=4096
```
